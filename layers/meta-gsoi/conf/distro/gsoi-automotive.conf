## layers/meta-gsoi/conf/distro/gsoi-automotive.conf
```bitbake
require conf/distro/poky.conf

DISTRO = "gsoi-automotive"

DISTRO_NAME = "GSOI Automotive OS"
DISTRO_VERSION = "0.1"
DISTRO_CODENAME = "genesis"

MAINTAINER = "GSOI Project"

INIT_MANAGER = "systemd"
```
